/***************************************************
  Made by DereK Joslin with help from Adafruit
  outputs simulated FC data
 ****************************************************/

#include "FC_mechanics.h"
#include <Wire.h>
#include <math.h>
#include <Adafruit_GFX.h>
#include "Adafruit_LEDBackpack.h"

int ts[20][20] = {{0, 0, 0, 0, 0, 0, 0, 0, 0, 0, 0, 0, 0, 0, 0, 0, 0, 0, 0, 0, },
  {0, 0, 0, 0, 0, 0, 0, 0, 0, 0, 0, 0, 0, 0, 0, 0, 0, 0, 0, 0, },
  {0, 0, 0, 0, 0, 0, 0, 0, 0, 0, 0, 0, 0, 0, 0, 0, 0, 0, 0, 0, },
  {0, 0, 0, 0, 0, 0, 0, 0, 0, 0, 0, 0, 0, 0, 0, 0, 0, 0, 0, 0, },
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  {0, 0, 0, 0, 0, 0, 0, 0, 0, 0, 0, 0, 0, 0, 0, 0, 0, 0, 0, 0, },
};

int th[20][20] = {{0, 0, 0, 0, 0, 0, 0, 0, 0, 0, 0, 0, 0, 0, 0, 0, 0, 0, 0, 0, },
  {0, 0, 0, 0, 0, 0, 0, 0, 0, 0, 0, 0, 0, 0, 0, 0, 0, 0, 0, 0, },
  {0, 0, 0, 0, 0, 0, 0, 0, 0, 0, 0, 0, 0, 0, 0, 0, 0, 0, 0, 0, },
  {0, 0, 0, 0, 0, 0, 0, 0, 0, 0, 0, 0, 0, 0, 0, 0, 0, 0, 0, 0, },
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  {0, 0, 0, 0, 0, 0, 0, 0, 0, 0, 0, 0, 0, 0, 0, 0, 0, 0, 0, 0, },
};

int tpw[20][20] = {{0, 0, 0, 0, 0, 0, 0, 0, 0, 0, 0, 0, 0, 0, 0, 0, 0, 0, 0, 0, },
  {0, 0, 0, 0, 0, 0, 0, 0, 0, 0, 0, 0, 0, 0, 0, 0, 0, 0, 0, 0, },
  {0, 0, 0, 0, 0, 0, 0, 0, 0, 0, 0, 0, 0, 0, 0, 0, 0, 0, 0, 0, },
  {0, 0, 0, 0, 0, 0, 0, 0, 0, 0, 0, 0, 0, 0, 0, 0, 0, 0, 0, 0, },
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  {0, 0, 0, 0, 0, 0, 0, 0, 0, 0, 0, 0, 0, 0, 0, 0, 0, 0, 0, 0, },
};

const uint8_t rows = 8;
const uint8_t columns = 8;

int elapsed_time;


uint8_t num = 0;
uint8_t output[rows] =
{ B00111100,
  B01000010,
  B10100101,
  B10000001,
  B10100101,
  B10011001,
  B01000010,
  B00111100
};

uint8_t old_output[rows] =
{ B00111100,
  B01000010,
  B10100101,
  B10000001,
  B10100101,
  B10011001,
  B01000010,
  B00111100
};

Adafruit_8x8matrix matrix = Adafruit_8x8matrix();
FC_mechanics FC = FC_mechanics(rows, columns, ts, th, tpw);

void setup() {
  Serial.begin(115200);
  Serial.println("8x8 LED Matrix Test");

  matrix.begin(0x70);  // pass in the address
}

void loop() {

  //elapsed_time = micros();
  FC.check_inputs();
  //extract each row and make them a binary number
  //Serial.println("state change");
  for (int i = 0; i < rows; i++) {
    num = 0;
    for (int j = columns; j > 0; j--) {
      //for each number insert it into num in the correct place
      num += pow(2, j) * FC.get_state(i, j);
    }
    //Serial.println(num);
    output[i] = num;
  }

  //elapsed_time = micros() - elapsed_time;
  //Serial.print("time to compute state "); Serial.println(elapsed_time);

  for (int i = 0; i < rows; i++) {
    if (output[i] != old_output[i]) {
      Serial.println("-----------------");
      for (int x = 0; x < rows; x++) {
        for (int y = 0; y < columns; y++) {
          Serial.print(FC.get_state(x, y)); Serial.print(" ");
        }
        Serial.println();
      }
      Serial.println("-----------------");
      for (int j = 0; j < rows; j++) {
        old_output[j] = output[j];
      }
      break;
    }
  }

  //  elapsed_time = micros();
  matrix.clear();
  matrix.drawBitmap(0, 0, output, 8, 8, LED_ON);
  matrix.writeDisplay();
  //elapsed_time = micros() - elapsed_time;
  //  Serial.print("time to compute display "); Serial.println(elapsed_time);
}
